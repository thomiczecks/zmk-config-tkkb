/* tkkb.dts */
/dts-v1/;
#include "tkkb.dtsi"

/ {
    /* This file stays empty unless you want to override 
       specific hardware settings or add peripheral-specific 
       nodes like a trackpad or encoder.
    */
};