## config/boards/arm/tkkb/Kconfig.board
```kconfig
# Copyright (c) 2024 The ZMK Contributors
# SPDX-License-Identifier: MIT

config BOARD_TKKB
	bool "tkkb"
	depends on SOC_NRF52840_QIAA
```

## config/boards/arm/tkkb/tkkb_defconfig
```kconfig
# SPDX-License-Identifier: MIT
CONFIG_SOC_SERIES_NRF52X=y
CONFIG_SOC_NRF52840_QIAA=y
CONFIG_BOARD_TKKB=y

# Enable deep sleep
CONFIG_ZMK_SLEEP=y

# Enable MPU
CONFIG_ARM_MPU=y

# Enable I2C
CONFIG_I2C=y
CONFIG_I2C_NRFX=y

#Enable SPI
CONFIG_SPI=y
CONFIG_SPI_NRFX=y
CONFIG_PINCTRL=y

CONFIG_WS2812_STRIP=y
CONFIG_ZMK_RGB_UNDERGLOW=y
CONFIG_ZMK_RGB_UNDERGLOW_ON_START=n

# not working
CONFIG_ZMK_RGB_UNDERGLOW_HUE_START=160
CONFIG_ZMK_RGB_UNDERGLOW_EFF_START=3

CONFIG_USE_DT_CODE_PARTITION=y
CONFIG_BUILD_OUTPUT_UF2=y

CONFIG_MPU_ALLOW_FLASH_WRITE=y
CONFIG_NVS=y
CONFIG_SETTINGS_NVS=y
CONFIG_FLASH=y
CONFIG_FLASH_PAGE_LAYOUT=y
CONFIG_FLASH_MAP=y

# Windows Battery Reporting Fix
CONFIG_BT_GATT_ENFORCE_SUBSCRIPTION=n

# Enable experimental BLE features to improve stability
CONFIG_ZMK_BLE=y
CONFIG_BT_CTLR_TX_PWR_PLUS_8=y
CONFIG_ZMK_BLE_EXPERIMENTAL_CONN=y

# Enable USB-Keyboard
CONFIG_ZMK_USB=y

# 12 Key rollover
CONFIG_ZMK_HID_REPORT_TYPE_NKRO=y
CONFIG_ZMK_HID_KEYBOARD_REPORT_SIZE=6

# basi Consumer control e.g. volume up/down etc.
CONFIG_ZMK_HID_CONSUMER_REPORT_USAGES_BASIC=y

# Turn on logging, and set ZMK logging to debug output
# CONFIG_LOG=y
# CONFIG_ZMK_USB_LOGGING=y
# CONFIG_ZMK_LOG_LEVEL_DBG=y
# CONFIG_I2C_LOG_LEVEL_DBG=y
# CONFIG_SENSOR_LOG_LEVEL_DBG=y
```

## config/boards/thomiczeck/tkkb/Kconfig.defconfig
```kconfig
# Copyright (c) 2024 The ZMK Contributors
# SPDX-License-Identifier: MIT

if BOARD_TKKB

config ZMK_KEYBOARD_NAME
	default "tkkb"

if USB

config USB_NRFX
	default y

config USB_DEVICE_STACK
	default y

endif # USB

config BT_CTLR
    default BT

endif # BOARD_TKKB
```

## config/boards/thomiczeck/tkkb/tkkb_defconfig
```kconfig
# Enable deep sleep
CONFIG_ZMK_SLEEP=y

# Enable MPU
CONFIG_ARM_MPU=y
CONFIG_MPU_ALLOW_FLASH_WRITE=y

CONFIG_NVS=y
CONFIG_SETTINGS_NVS=y
CONFIG_FLASH=y
CONFIG_FLASH_PAGE_LAYOUT=y
CONFIG_FLASH_MAP=y

CONFIG_USE_DT_CODE_PARTITION=y
CONFIG_BUILD_OUTPUT_UF2=y

# Enable I2C
CONFIG_I2C=y
CONFIG_I2C_NRFX=y
CONFIG_ZMK_MAX17048=y

CONFIG_PINCTRL=y

CONFIG_ZMK_RGB_UNDERGLOW=y
CONFIG_ZMK_RGB_UNDERGLOW_ON_START=n
CONFIG_ZMK_RGB_UNDERGLOW_HUE_START=160
CONFIG_ZMK_RGB_UNDERGLOW_EFF_START=3

CONFIG_ZMK_BATTERY_REPORTING=y

# Enable experimental BLE features to improve stability
CONFIG_ZMK_BLE=y
#CONFIG_BT_CTLR_TX_PWR_PLUS_8=y
#CONFIG_ZMK_BLE_EXPERIMENTAL_CONN=y

# Enable USB-Keyboard
CONFIG_ZMK_USB=y

# basi Consumer control e.g. volume up/down etc.
CONFIG_ZMK_HID_CONSUMER_REPORT_USAGES_BASIC=y
CONFIG_ZMK_BOOTMODE_MAGIC_VALUE_BOOTLOADER_TYPE_ADAFRUIT_NRF52=y
```
